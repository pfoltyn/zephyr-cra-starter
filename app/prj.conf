## CMakeLists.txt
```
# SPDX-License-Identifier: Apache-2.0

cmake_minimum_required(VERSION 3.20.0)
find_package(Zephyr REQUIRED HINTS $ENV{ZEPHYR_BASE})

project(twin_sensor_app LANGUAGES C)

target_sources(app PRIVATE
  src/main.c
  src/sensors.c
  src/app_settings.c
  src/app_shell.c
)
target_sources_ifdef(CONFIG_APP_BLE app PRIVATE src/ble.c)
```

## Kconfig
```
# SPDX-License-Identifier: Apache-2.0

menu "Twin Sensor application"

config APP_BLE
	bool "Advertise readings over Bluetooth LE (Environmental Sensing Service)"
	default y
	select BT
	select BT_PERIPHERAL

config APP_SAMPLE_INTERVAL_MS
	int "Default sampling interval (ms); overridable at runtime via settings"
	default 2000
	range 100 3600000

module = APP
module-str = app
source "subsys/logging/Kconfig.template.log_config"

endmenu

source "Kconfig.zephyr"
```

## sysbuild.conf
```
# MCUboot as the immutable first-stage bootloader; application images are
# signed with ECDSA P-256. The key file defaults to MCUboot's PUBLIC DEV KEY
# (fine for the twin and development, NEVER for production). Release builds
# pass -DSB_CONFIG_BOOT_SIGNATURE_KEY_FILE=<path to secret key>, see docs/cra/.
SB_CONFIG_BOOTLOADER_MCUBOOT=y
SB_CONFIG_BOOT_SIGNATURE_TYPE_ECDSA_P256=y
```

## prj.conf
```kconfig
# --- Core -------------------------------------------------------------------
CONFIG_LOG=y
CONFIG_LOG_MODE_DEFERRED=y
CONFIG_ASSERT=n
CONFIG_HW_STACK_PROTECTION=y
CONFIG_REBOOT=y
CONFIG_HWINFO=y

# --- Shell (UART) -------------------------------------------------------------
CONFIG_SHELL=y
CONFIG_SHELL_BACKEND_SERIAL=y
CONFIG_KERNEL_SHELL=y
CONFIG_DEVICE_SHELL=y

# --- Drivers ----------------------------------------------------------------
CONFIG_GPIO=y
CONFIG_I2C=y
CONFIG_SENSOR=y
CONFIG_WATCHDOG=y

# --- Power management defaults ----------------------------------------------
# nRF52 idles in System ON sleep automatically; devices can be suspended.
CONFIG_PM_DEVICE=y
# PM_DEVICE_RUNTIME is off: with it on, the twin shows the TWI interrupt
# disabled before the first sensor transfer (sensors fail to probe).
# Reproduce on an nRF52840 DK before enabling; tracked in docs/twin-findings.md.
# CONFIG_PM_DEVICE_RUNTIME=y

# --- Settings storage (ZMS on the "storage" partition) -------------------------
CONFIG_FLASH=y
CONFIG_FLASH_MAP=y
CONFIG_ZMS=y
CONFIG_SETTINGS=y
CONFIG_SETTINGS_ZMS=y
CONFIG_SETTINGS_RUNTIME=y

# --- Bluetooth LE -----------------------------------------------------------
CONFIG_BT_DEVICE_NAME="Twin Sensor"
CONFIG_BT_DEVICE_APPEARANCE=1344
CONFIG_BT_SETTINGS=y
CONFIG_BT_RX_STACK_SIZE=2048

# --- Security / update hooks (see docs/cra/) ------------------------------------
# Sysbuild adds MCUboot and signs the image; the application confirms itself after a
# successful self-test so a broken update is rolled back.
CONFIG_STREAM_FLASH=y
CONFIG_IMG_MANAGER=y
CONFIG_MCUBOOT_IMG_MANAGER=y
CONFIG_MCUBOOT_SHELL=y
CONFIG_STACK_CANARIES=y

# --- SBOM: needed by `west spdx` (see scripts/sbom.sh) ---
CONFIG_BUILD_OUTPUT_META=y
```

## src/main.c
```c
/*
 * Twin Sensor Node application entry point.
 *
 * SPDX-License-Identifier: Apache-2.0
 */

#include <zephyr/kernel.h>
#include <zephyr/device.h>
#include <zephyr/drivers/gpio.h>
#include <zephyr/drivers/watchdog.h>
#include <zephyr/dfu/mcuboot.h>
#include <zephyr/logging/log.h>

#include <app_version.h>
#include "app.h"

LOG_MODULE_REGISTER(app, CONFIG_APP_LOG_LEVEL);

#define WDT_TIMEOUT_MS 8000
#define HEARTBEAT_MS   1000

static const struct gpio_dt_spec led = GPIO_DT_SPEC_GET(DT_ALIAS(led0), gpios);
static const struct gpio_dt_spec button = GPIO_DT_SPEC_GET(DT_ALIAS(sw0), gpios);
static const struct device *const wdt = DEVICE_DT_GET(DT_ALIAS(watchdog0));
static struct gpio_callback button_cb;
static int wdt_channel = -1;

static void button_pressed(const struct device *dev, struct gpio_callback *cb, uint32_t pins)
{
	ARG_UNUSED(dev);
	ARG_UNUSED(cb);
	ARG_UNUSED(pins);
	LOG_INF("button: pressed");
}

static int io_init(void)
{
	int err;

	if (!gpio_is_ready_dt(&led) || !gpio_is_ready_dt(&button)) {
		return -ENODEV;
	}
	err = gpio_pin_configure_dt(&led, GPIO_OUTPUT_INACTIVE);
	if (err) {
		return err;
	}
	err = gpio_pin_configure_dt(&button, GPIO_INPUT);
	if (err) {
		return err;
	}
	err = gpio_pin_interrupt_configure_dt(&button, GPIO_INT_EDGE_TO_ACTIVE);
	if (err) {
		return err;
	}
	gpio_init_callback(&button_cb, button_pressed, BIT(button.pin));
	return gpio_add_callback_dt(&button, &button_cb);
}

static int watchdog_init(void)
{
	struct wdt_timeout_cfg cfg = {
		.window = {.min = 0, .max = WDT_TIMEOUT_MS},
		.flags = WDT_FLAG_RESET_SOC,
	};

	if (!device_is_ready(wdt)) {
		return -ENODEV;
	}
	wdt_channel = wdt_install_timeout(wdt, &cfg);
	if (wdt_channel < 0) {
		return wdt_channel;
	}
	return wdt_setup(wdt, WDT_OPT_PAUSE_HALTED_BY_DBG);
}

/*
 * Confirm the running image only after the product's critical functions came
 * up. If an update is broken, MCUboot reverts to the previous image on the
 * next reset.
 */
static void confirm_image(bool healthy)
{
	if (boot_is_img_confirmed()) {
		return;
	}
	if (!healthy) {
		LOG_ERR("self-test failed, image left unconfirmed (will revert on reset)");
		return;
	}
	if (boot_write_img_confirmed() == 0) {
		LOG_INF("image confirmed");
	}
}

int main(void)
{
	bool healthy = true;
	int err;

	LOG_INF("twin_sensor v%s (%s) starting", APP_VERSION_STRING, CONFIG_BOARD_TARGET);

	err = io_init();
	if (err) {
		LOG_ERR("io init failed (%d)", err);
		healthy = false;
	}
	err = app_settings_init();
	if (err) {
		LOG_ERR("settings init failed (%d)", err);
		healthy = false;
	}
	err = sensors_init();
	if (err) {
		LOG_ERR("sensor init failed (%d)", err);
		healthy = false;
	}
	if (IS_ENABLED(CONFIG_APP_BLE)) {
		err = ble_init();
		if (err) {
			LOG_ERR("bluetooth init failed (%d)", err);
			healthy = false;
		}
	}
	err = watchdog_init();
	if (err) {
		LOG_WRN("watchdog not started (%d)", err);
	}

	confirm_image(healthy);
	LOG_INF("self-test %s", healthy ? "passed" : "FAILED");

	while (true) {
		gpio_pin_toggle_dt(&led);
		if (wdt_channel >= 0) {
			wdt_feed(wdt, wdt_channel);
		}
		k_msleep(HEARTBEAT_MS);
	}
	return 0;
}
```

## src/app.h
```c
/*
 * SPDX-License-Identifier: Apache-2.0
 */

#ifndef APP_H_
#define APP_H_

#include <stdbool.h>
#include <stdint.h>

struct app_reading {
	bool env_valid;
	int32_t temp_centi_c;    /* 0.01 degC */
	uint32_t humidity_centi; /* 0.01 %RH */
	uint32_t pressure_pa;
	bool accel_valid;
	int32_t accel_milli_g[3];
	uint32_t seq;
};

int sensors_init(void);
void sensors_get_latest(struct app_reading *out);

int app_settings_init(void);
uint32_t app_settings_interval_ms(void);
int app_settings_set_interval_ms(uint32_t ms);

int ble_init(void);
void ble_publish(const struct app_reading *r);

#endif /* APP_H_ */
```

## src/app_settings.c
```c
/*
 * Persistent application settings ("app/..." in the settings subsystem).
 *
 * SPDX-License-Identifier: Apache-2.0
 */

#include <zephyr/kernel.h>
#include <zephyr/settings/settings.h>
#include <zephyr/logging/log.h>

#include "app.h"

LOG_MODULE_REGISTER(app_settings, CONFIG_APP_LOG_LEVEL);

static uint32_t interval_ms = CONFIG_APP_SAMPLE_INTERVAL_MS;

static int app_set(const char *name, size_t len, settings_read_cb read_cb, void *cb_arg)
{
	if (settings_name_steq(name, "interval", NULL) && len == sizeof(interval_ms)) {
		uint32_t v;

		if (read_cb(cb_arg, &v, sizeof(v)) == sizeof(v) && v >= 100) {
			interval_ms = v;
		}
		return 0;
	}
	return -ENOENT;
}

SETTINGS_STATIC_HANDLER_DEFINE(app, "app", NULL, app_set, NULL, NULL);

int app_settings_init(void)
{
	int err = settings_subsys_init();

	if (err) {
		return err;
	}
	err = settings_load();
	LOG_INF("sample interval %u ms", interval_ms);
	return err;
}

uint32_t app_settings_interval_ms(void)
{
	return interval_ms;
}

int app_settings_set_interval_ms(uint32_t ms)
{
	if (ms < 100) {
		return -EINVAL;
	}
	interval_ms = ms;
	return settings_save_one("app/interval", &interval_ms, sizeof(interval_ms));
}
```

## src/app_shell.c
```c
/*
 * "app" shell commands: status, interval.
 *
 * SPDX-License-Identifier: Apache-2.0
 */

#include <stdlib.h>
#include <zephyr/shell/shell.h>

#include <app_version.h>
#include "app.h"

static int cmd_status(const struct shell *sh, size_t argc, char **argv)
{
	struct app_reading r;

	ARG_UNUSED(argc);
	ARG_UNUSED(argv);
	sensors_get_latest(&r);
	shell_print(sh, "version: %s", APP_VERSION_STRING);
	shell_print(sh, "interval: %u ms", app_settings_interval_ms());
	shell_print(sh, "samples: %u", r.seq);
	if (r.env_valid) {
		shell_print(sh, "temperature: %d.%02d C", r.temp_centi_c / 100, abs(r.temp_centi_c % 100));
		shell_print(sh, "humidity: %u.%02u %%", r.humidity_centi / 100, r.humidity_centi % 100);
		shell_print(sh, "pressure: %u Pa", r.pressure_pa);
	}
	if (r.accel_valid) {
		shell_print(sh, "accel: %d %d %d mg", r.accel_milli_g[0], r.accel_milli_g[1],
			    r.accel_milli_g[2]);
	}
	return 0;
}

static int cmd_interval(const struct shell *sh, size_t argc, char **argv)
{
	if (argc == 1) {
		shell_print(sh, "interval: %u ms", app_settings_interval_ms());
		return 0;
	}
	char *end;
	unsigned long ms = strtoul(argv[1], &end, 10);

	if (*end != '\0' || app_settings_set_interval_ms(ms) != 0) {
		shell_error(sh, "invalid interval (min 100 ms) or storage error");
		return -EINVAL;
	}
	shell_print(sh, "interval set to %lu ms (saved)", ms);
	return 0;
}

SHELL_STATIC_SUBCMD_SET_CREATE(app_cmds,
	SHELL_CMD(status, NULL, "Show latest readings and configuration", cmd_status),
	SHELL_CMD_ARG(interval, NULL, "Get/set sampling interval in ms (persisted)", cmd_interval,
		      1, 1),
	SHELL_SUBCMD_SET_END);
SHELL_CMD_REGISTER(app, &app_cmds, "Twin Sensor application commands", NULL);
```

## src/ble.c
```c
/*
 * Bluetooth LE: connectable advertising + Environmental Sensing Service with
 * temperature and humidity characteristics (read + notify).
 *
 * SPDX-License-Identifier: Apache-2.0
 */

#include <zephyr/kernel.h>
#include <zephyr/bluetooth/bluetooth.h>
#include <zephyr/bluetooth/conn.h>
#include <zephyr/bluetooth/gatt.h>
#include <zephyr/bluetooth/uuid.h>
#include <zephyr/settings/settings.h>
#include <zephyr/logging/log.h>

#include "app.h"

LOG_MODULE_REGISTER(ble, CONFIG_APP_LOG_LEVEL);

static int16_t ess_temp;    /* 0.01 degC, per GATT Temperature characteristic */
static uint16_t ess_humid;  /* 0.01 %RH, per GATT Humidity characteristic */

static ssize_t read_u16(struct bt_conn *conn, const struct bt_gatt_attr *attr, void *buf,
			uint16_t len, uint16_t offset)
{
	return bt_gatt_attr_read(conn, attr, buf, len, offset, attr->user_data, sizeof(uint16_t));
}

static void ccc_changed(const struct bt_gatt_attr *attr, uint16_t value)
{
	ARG_UNUSED(attr);
	LOG_INF("notifications %s", value == BT_GATT_CCC_NOTIFY ? "on" : "off");
}

BT_GATT_SERVICE_DEFINE(ess_svc,
	BT_GATT_PRIMARY_SERVICE(BT_UUID_ESS),
	BT_GATT_CHARACTERISTIC(BT_UUID_TEMPERATURE, BT_GATT_CHRC_READ | BT_GATT_CHRC_NOTIFY,
			       BT_GATT_PERM_READ, read_u16, NULL, &ess_temp),
	BT_GATT_CCC(ccc_changed, BT_GATT_PERM_READ | BT_GATT_PERM_WRITE),
	BT_GATT_CHARACTERISTIC(BT_UUID_HUMIDITY, BT_GATT_CHRC_READ | BT_GATT_CHRC_NOTIFY,
			       BT_GATT_PERM_READ, read_u16, NULL, &ess_humid),
	BT_GATT_CCC(ccc_changed, BT_GATT_PERM_READ | BT_GATT_PERM_WRITE),
);

static const struct bt_data ad[] = {
	BT_DATA_BYTES(BT_DATA_FLAGS, (BT_LE_AD_GENERAL | BT_LE_AD_NO_BREDR)),
	BT_DATA_BYTES(BT_DATA_UUID16_ALL, BT_UUID_16_ENCODE(BT_UUID_ESS_VAL)),
};

static const struct bt_data sd[] = {
	BT_DATA(BT_DATA_NAME_COMPLETE, CONFIG_BT_DEVICE_NAME, sizeof(CONFIG_BT_DEVICE_NAME) - 1),
};

static void connected(struct bt_conn *conn, uint8_t err)
{
	ARG_UNUSED(conn);
	if (err) {
		LOG_WRN("connection failed (0x%02x)", err);
	} else {
		LOG_INF("connected");
	}
}

static void disconnected(struct bt_conn *conn, uint8_t reason)
{
	ARG_UNUSED(conn);
	LOG_INF("disconnected (0x%02x)", reason);
}

static void recycled(void)
{
	/* Connection object freed: resume advertising. */
	int err = bt_le_adv_start(BT_LE_ADV_CONN_FAST_1, ad, ARRAY_SIZE(ad), sd, ARRAY_SIZE(sd));

	if (err && err != -EALREADY) {
		LOG_ERR("advertising restart failed (%d)", err);
	}
}

BT_CONN_CB_DEFINE(conn_callbacks) = {
	.connected = connected,
	.disconnected = disconnected,
	.recycled = recycled,
};

int ble_init(void)
{
	int err = bt_enable(NULL);

	if (err) {
		return err;
	}
	if (IS_ENABLED(CONFIG_BT_SETTINGS)) {
		settings_load_subtree("bt");
	}
	err = bt_le_adv_start(BT_LE_ADV_CONN_FAST_1, ad, ARRAY_SIZE(ad), sd, ARRAY_SIZE(sd));
	if (err) {
		return err;
	}
	LOG_INF("advertising as \"%s\"", CONFIG_BT_DEVICE_NAME);
	return 0;
}

void ble_publish(const struct app_reading *r)
{
	if (!r->env_valid) {
		return;
	}
	ess_temp = (int16_t)r->temp_centi_c;
	ess_humid = (uint16_t)r->humidity_centi;
	bt_gatt_notify(NULL, &ess_svc.attrs[2], &ess_temp, sizeof(ess_temp));
	bt_gatt_notify(NULL, &ess_svc.attrs[5], &ess_humid, sizeof(ess_humid));
}
```

## src/sensors.c
```c
/*
 * Periodic sampling of the environment sensor and accelerometer.
 *
 * SPDX-License-Identifier: Apache-2.0
 */

#include <stdlib.h>
#include <zephyr/kernel.h>
#include <zephyr/device.h>
#include <zephyr/drivers/sensor.h>
#include <zephyr/logging/log.h>

#include "app.h"

LOG_MODULE_REGISTER(sensors, CONFIG_APP_LOG_LEVEL);

static const struct device *const env = DEVICE_DT_GET(DT_ALIAS(env));
static const struct device *const accel = DEVICE_DT_GET(DT_ALIAS(accel));

static struct app_reading latest;
static K_MUTEX_DEFINE(latest_lock);
static void sample_work_fn(struct k_work *work);
static K_WORK_DELAYABLE_DEFINE(sample_work, sample_work_fn);

static bool read_env(struct app_reading *r)
{
	struct sensor_value t, h, p;

	if (sensor_sample_fetch(env) ||
	    sensor_channel_get(env, SENSOR_CHAN_AMBIENT_TEMP, &t) ||
	    sensor_channel_get(env, SENSOR_CHAN_HUMIDITY, &h) ||
	    sensor_channel_get(env, SENSOR_CHAN_PRESS, &p)) {
		return false;
	}
	r->temp_centi_c = t.val1 * 100 + t.val2 / 10000;
	r->humidity_centi = h.val1 * 100 + h.val2 / 10000;
	/* Zephyr reports pressure in kPa. */
	r->pressure_pa = p.val1 * 1000 + p.val2 / 1000;
	return true;
}

static bool read_accel(struct app_reading *r)
{
	struct sensor_value xyz[3];

	if (sensor_sample_fetch(accel) || sensor_channel_get(accel, SENSOR_CHAN_ACCEL_XYZ, xyz)) {
		return false;
	}
	for (int i = 0; i < 3; i++) {
		/* m/s^2 -> milli-g */
		r->accel_milli_g[i] = (int32_t)(sensor_value_to_micro(&xyz[i]) / 9807);
	}
	return true;
}

static void sample_work_fn(struct k_work *work)
{
	struct app_reading r = {0};

	ARG_UNUSED(work);

	r.env_valid = read_env(&r);
	r.accel_valid = read_accel(&r);

	k_mutex_lock(&latest_lock, K_FOREVER);
	r.seq = latest.seq + 1;
	latest = r;
	k_mutex_unlock(&latest_lock);

	if (r.env_valid) {
		LOG_INF("env: t=%d.%02d C rh=%u.%02u %% p=%u Pa", r.temp_centi_c / 100,
			abs(r.temp_centi_c % 100), r.humidity_centi / 100, r.humidity_centi % 100,
			r.pressure_pa);
	} else {
		LOG_WRN("env: read failed");
	}
	if (r.accel_valid) {
		LOG_INF("accel: x=%d y=%d z=%d mg", r.accel_milli_g[0], r.accel_milli_g[1],
			r.accel_milli_g[2]);
	} else {
		LOG_WRN("accel: read failed");
	}

	if (IS_ENABLED(CONFIG_APP_BLE)) {
		ble_publish(&r);
	}
	k_work_schedule(&sample_work, K_MSEC(app_settings_interval_ms()));
}

int sensors_init(void)
{
	int missing = 0;

	if (!device_is_ready(env)) {
		LOG_ERR("%s not ready", env->name);
		missing++;
	}
	if (!device_is_ready(accel)) {
		LOG_ERR("%s not ready", accel->name);
		missing++;
	}
	k_work_schedule(&sample_work, K_NO_WAIT);
	return missing ? -ENODEV : 0;
}

void sensors_get_latest(struct app_reading *out)
{
	k_mutex_lock(&latest_lock, K_FOREVER);
	*out = latest;
	k_mutex_unlock(&latest_lock);
}
```
