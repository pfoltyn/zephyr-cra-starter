## boards/boardtwin/twin_sensor/Kconfig.defconfig
```kconfig
# SPDX-License-Identifier: Apache-2.0

if BOARD_TWIN_SENSOR

config HW_STACK_PROTECTION
	default ARCH_HAS_STACK_PROTECTION

endif # BOARD_TWIN_SENSOR
```

## boards/boardtwin/twin_sensor/board.yml
```yaml
board:
  name: twin_sensor
  full_name: Twin Sensor Node
  vendor: boardtwin
  revision:
    format: letter
    default: "A"
    revisions:
      - name: "A"
  socs:
    - name: nrf52840
```
